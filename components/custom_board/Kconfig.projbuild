## components/wifi_interface/Kconfig.projbuild
```kconfig
menu "Wifi Configuration"
    config ENABLE_WIFI_PROVISIONING
        bool "enable WiFi provisioning"
        default n
        help
            Enable WiFi provisioning through improv WiFi (https://github.com/improv-wifi), try it using https://web.esphome.io/

    config WIFI_SSID
        string "WiFi SSID"
        default "myssid"
        depends on !ENABLE_WIFI_PROVISIONING
        help
            SSID (network name) for the example to connect to.

    config WIFI_PASSWORD
        string "WiFi Password"
        default "mypassword"
        depends on !ENABLE_WIFI_PROVISIONING
        help
            WiFi password (WPA or WPA2) for the example to use.

    config WIFI_MAXIMUM_RETRY
        int "Maximum connection retry"
        default 5
        help
            Set the Maximum retry to avoid station reconnecting to the AP unlimited when the AP is really inexistent.
            Set to 0 if unlimited reconnections are preferred.
endmenu
```
